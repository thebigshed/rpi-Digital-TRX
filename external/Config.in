## external/Config.in
```kconfig
source "$BR2_EXTERNAL_DTRX_PATH/package/codec2/Config.in"
source "$BR2_EXTERNAL_DTRX_PATH/package/digital-transceiver/Config.in"
```

## external/package/codec2/Config.in
```kconfig
config BR2_PACKAGE_CODEC2
	bool "codec2"
	help
	  Codec2 low bit rate speech codec (used by M17).

	  https://github.com/drowe67/codec2
```

## external/package/digital-transceiver/Config.in
```kconfig
config BR2_PACKAGE_DIGITAL_TRANSCEIVER
	bool "digital-transceiver"
	depends on BR2_PACKAGE_QT6
	select BR2_PACKAGE_QT6BASE
	select BR2_PACKAGE_QT6BASE_NETWORK
	select BR2_PACKAGE_CODEC2
	select BR2_PACKAGE_ALSA_LIB
	help
	  The rpi-Digital-TRX radio app (app/ in this project): a network
	  radio for DMR, D-Star, YSF, P25, NXDN, M17 and DAPNET, driving
	  the LCD plate. Qt Core and Network only; no GUI.
```
